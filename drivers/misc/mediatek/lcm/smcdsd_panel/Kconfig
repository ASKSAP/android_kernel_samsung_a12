## drivers/misc/mediatek/lcm/smcdsd_panel/Kconfig
```kconfig
config SMCDSD_PANEL
	bool "Samsung Mobile Communication Division System Display"
	default y

source "drivers/misc/mediatek/lcm/smcdsd_panel/panels/Kconfig"
```
